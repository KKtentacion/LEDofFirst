# file: BreathingLight.ioc
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Mcu.Family=STM32F4
Mcu.Name=STM32F427I(G-I)Hx
Mcu.Package=UFBGA176
NVIC.PriorityGroup=NVIC_PRIORITYGROUP_4
PA13.Mode=Serial_Wire
PA13.Signal=SYS_JTMS-SWDIO
PA14.Mode=Serial_Wire
PA14.Signal=SYS_JTCK-SWCLK
PE11.Signal=S_TIM1_CH2
PH0/OSC_IN.Mode=HSE-External-Oscillator
PH0/OSC_IN.Signal=RCC_OSC_IN
PH1/OSC_OUT.Mode=HSE-External-Oscillator
PH1/OSC_OUT.Signal=RCC_OSC_OUT
ProjectManager.HeapSize=0x200
ProjectManager.StackSize=0x400
ProjectManager.TargetToolchain=MDK-ARM V5.32
RCC.AHBFreq_Value=16000000
RCC.APB1Freq_Value=16000000
RCC.APB2Freq_Value=16000000
RCC.CortexFreq_Value=16000000
RCC.HSE_VALUE=25000000
RCC.HSI_VALUE=16000000
RCC.LSE_VALUE=32768
RCC.SYSCLKFreq_VALUE=16000000
RCC.VCOOutputFreq_Value=192000000
SH.S_TIM1_CH2.0=TIM1_CH2,PWM Generation2 CH2
TIM1.Channel-PWM\ Generation2\ CH2=TIM_CHANNEL_2
TIM1.Period=19999
TIM1.Prescaler=179
TIM1.Pulse-PWM\ Generation2\ CH2=2000
board=custom

// file: Core/Src/main.c
/* USER CODE BEGIN Header */
/**
  ******************************************************************************
  * @file           : main.c
  * @brief          : Main program body
  ******************************************************************************
  * @attention
  *
  * Copyright (c) 2023 STMicroelectronics.
  * All rights reserved.
  *
  * This software is licensed under terms that can be found in the LICENSE file
  * in the root directory of this software component.
  * If no LICENSE file comes with this software, it is provided AS-IS.
  *
  ******************************************************************************
  */
/* USER CODE END Header */
#include "main.h"
#include "tim.h"
#include "gpio.h"

/* USER CODE BEGIN PD */
#define RGB_FLOW_COLOR_CHANGE_TIME 500;//呼吸灯每次改变的总时间
/* USER CODE END PD */

/* USER CODE BEGIN PV */
uint16_t RGB_flow_color[4]={0x0808,0xFFFF,0x0808,0x0000};//分别设置4个预设值来控制RGB的状态
uint8_t i=0;
/* USER CODE END PV */

void SystemClock_Config(void);
/* USER CODE BEGIN PFP */
void aRGB_led_show(uint16_t aRGB);//通过aRGB来显示RGB灯光
/* USER CODE END PFP */

int main(void)
{

  /* MCU Configuration--------------------------------------------------------*/

  /* Reset of all peripherals, Initializes the Flash interface and the Systick. */
  HAL_Init();

  /* Configure the system clock */
  SystemClock_Config();

  /* Initialize all configured peripherals */
  MX_GPIO_Init();
  MX_TIM1_Init();
  /* USER CODE BEGIN 2 */
  HAL_TIM_Base_Start(&htim1);//启用时钟
  HAL_TIM_PWM_Start(&htim1,TIM_CHANNEL_2);//启用PWM

  /* USER CODE END 2 */

  /* Infinite loop */
  while (1)
  {
    float alpha=((RGB_flow_color[i]&0xFF00)>>16);//将这次状态的alpha提取出来
    float red=((RGB_flow_color[i]&0x00FF)>>0);//将这次状态的red值提取出来

    float delta_alpha=((RGB_flow_color[i+1]&0xFF00)>>16)-((RGB_flow_color[i]&0x00FF)>>16);//这次循环需要改变的alpha
    float delta_red=((RGB_flow_color[i+1]&0xFF00)>>0)-((RGB_flow_color[i]&0x00FF)>>0);//这次需要改变的red亮度

    delta_alpha/=RGB_FLOW_COLOR_CHANGE_TIME;//每一次循环需要改变的量
    delta_red/=RGB_FLOW_COLOR_CHANGE_TIME;

    for(uint16_t j=0;j<500;j++)
      {
        alpha+=delta_alpha;//这次循环的alpha值
        red+=delta_red;//这次循环的red值

        uint16_t aRGB=((uint16_t)(alpha))<<16|((uint16_t)(red))<<0;//通过左移运算符来组成需要的16位aRGB值
        aRGB_led_show(aRGB);
        HAL_Delay(1);
      }
    i++;
  }
}

void SystemClock_Config(void)
{
  RCC_OscInitTypeDef RCC_OscInitStruct = {0};
  RCC_ClkInitTypeDef RCC_ClkInitStruct = {0};

  /** Configure the main internal regulator output voltage
  */
  __HAL_RCC_PWR_CLK_ENABLE();
  __HAL_PWR_VOLTAGESCALING_CONFIG(PWR_REGULATOR_VOLTAGE_SCALE3);

  /** Initializes the RCC Oscillators according to the specified parameters
  * in the RCC_OscInitTypeDef structure.
  */
  RCC_OscInitStruct.OscillatorType = RCC_OSCILLATORTYPE_HSI;
  RCC_OscInitStruct.HSIState = RCC_HSI_ON;
  RCC_OscInitStruct.HSICalibrationValue = RCC_HSICALIBRATION_DEFAULT;
  RCC_OscInitStruct.PLL.PLLState = RCC_PLL_NONE;
  if (HAL_RCC_OscConfig(&RCC_OscInitStruct) != HAL_OK)
  {
    Error_Handler();
  }

  /** Initializes the CPU, AHB and APB buses clocks
  */
  RCC_ClkInitStruct.ClockType = RCC_CLOCKTYPE_HCLK|RCC_CLOCKTYPE_SYSCLK
                              |RCC_CLOCKTYPE_PCLK1|RCC_CLOCKTYPE_PCLK2;
  RCC_ClkInitStruct.SYSCLKSource = RCC_SYSCLKSOURCE_HSI;
  RCC_ClkInitStruct.AHBCLKDivider = RCC_SYSCLK_DIV1;
  RCC_ClkInitStruct.APB1CLKDivider = RCC_HCLK_DIV1;
  RCC_ClkInitStruct.APB2CLKDivider = RCC_HCLK_DIV1;

  if (HAL_RCC_ClockConfig(&RCC_ClkInitStruct, FLASH_LATENCY_0) != HAL_OK)
  {
    Error_Handler();
  }
}

/* USER CODE BEGIN 4 */
void aRGB_led_show(uint16_t aRGB){
    static uint8_t alpha;
    static uint16_t red;

    alpha=(aRGB&0xFF00)>>8;
    red=((aRGB&0x00FF)>>0)*alpha;

    __HAL_TIM_SetCompare(&htim1,TIM_CHANNEL_2,red);//设置红灯的PWM值来控制亮度实现呼吸的效果
}
/* USER CODE END 4 */

void Error_Handler(void)
{
  __disable_irq();
  while (1)
  {
  }
}
